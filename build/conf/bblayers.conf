## build/conf/bblayers.conf
```bitbake
# POKY_BBLAYERS_CONF_VERSION is increased each time build/conf/bblayers.conf
# changes incompatibly
POKY_BBLAYERS_CONF_VERSION = "2"

BBPATH = "${TOPDIR}"
BBFILES ?= ""

BBLAYERS ?= " \
  /home/osboxes/Repository/yocto-ostree-integration/poky/meta \
  /home/osboxes/Repository/yocto-ostree-integration/poky/meta-poky \
  /home/osboxes/Repository/yocto-ostree-integration/poky/meta-updater \
  /home/osboxes/Repository/yocto-ostree-integration/poky/meta-openembedded/meta-filesystems \
  /home/osboxes/Repository/yocto-ostree-integration/poky/meta-openembedded/meta-python \
  /home/osboxes/Repository/yocto-ostree-integration/poky/meta-openembedded/meta-oe \
  /home/osboxes/Repository/yocto-ostree-integration/poky/meta-updater-qemux86-64 \
  /home/osboxes/Repository/yocto-ostree-integration/poky/meta-yocto-bsp \
  "
```
